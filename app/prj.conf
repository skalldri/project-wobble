## CMakeLists.txt
```
set(BOARD, nrf52_pca10040)
set(CONF_FILE, )
include($ENV{ZEPHYR_BASE}/cmake/app/boilerplate.cmake NO_POLICY_SCOPE)
project(wobble)
target_sources(app PRIVATE 
    src/main.c
    src/imu.c
    src/temperature.c)
```

## prj.conf
```kconfig
# Generated by Kconfiglib (https://github.com/ulfalizer/Kconfiglib)
# CONFIG_ARC is not set
CONFIG_ARM=y
# CONFIG_X86 is not set
# CONFIG_NIOS2 is not set
# CONFIG_RISCV32 is not set
# CONFIG_XTENSA is not set
# CONFIG_ARCH_POSIX is not set

#
# General Architecture Options
#
# CONFIG_HW_STACK_PROTECTION is not set
# CONFIG_USERSPACE is not set
CONFIG_PRIVILEGED_STACK_SIZE=256
# CONFIG_STACK_GROWS_UP is not set
# CONFIG_SIMPLE_FATAL_ERROR_HANDLER is not set

#
# Interrupt Configuration
#
CONFIG_GEN_ISR_TABLES=y
CONFIG_GEN_IRQ_VECTOR_TABLE=y
CONFIG_GEN_SW_ISR_TABLE=y
CONFIG_GEN_IRQ_START_VECTOR=0
# CONFIG_IRQ_OFFLOAD is not set
CONFIG_ARCH_HAS_STACK_PROTECTION=y
CONFIG_ARCH_HAS_USERSPACE=y
CONFIG_ARCH_HAS_EXECUTABLE_PAGE_BIT=y
CONFIG_ARCH_HAS_THREAD_ABORT=y
CONFIG_SYS_POWER_LOW_POWER_STATE_SUPPORTED=y
CONFIG_SYS_POWER_DEEP_SLEEP_SUPPORTED=y
CONFIG_CPU_HAS_FPU=y
CONFIG_CPU_HAS_MPU=y
CONFIG_MPU_REQUIRES_POWER_OF_TWO_ALIGNMENT=y

#
# Floating Point Options
#
# CONFIG_FLOAT is not set
CONFIG_ARCH="arm"
CONFIG_SOC="nRF52832_QFAA"
CONFIG_SOC_SERIES="nrf52"
CONFIG_SOC_FAMILY="nordic_nrf"
CONFIG_BOARD="nrf52_pca10040"
# CONFIG_SOC_SERIES_BEETLE is not set
# CONFIG_SOC_SERIES_MPS2 is not set
# CONFIG_SOC_SERIES_SAMD21 is not set
# CONFIG_SOC_SERIES_SAM3X is not set
# CONFIG_SOC_SERIES_SAM4S is not set
# CONFIG_SOC_SERIES_SAME70 is not set
# CONFIG_SOC_SERIES_NRF51X is not set
CONFIG_SOC_SERIES_NRF52X=y
# CONFIG_SOC_SERIES_IMX_6X_M4 is not set
# CONFIG_SOC_SERIES_IMX7_M4 is not set
# CONFIG_SOC_SERIES_IMX_RT is not set
# CONFIG_SOC_SERIES_KINETIS_K6X is not set
# CONFIG_SOC_SERIES_KINETIS_KL2X is not set
# CONFIG_SOC_SERIES_KINETIS_KWX is not set
# CONFIG_SOC_SERIES_LPC54XXX is not set
# CONFIG_SOC_SERIES_EFM32WG is not set
# CONFIG_SOC_SERIES_STM32F0X is not set
# CONFIG_SOC_SERIES_STM32F1X is not set
# CONFIG_SOC_SERIES_STM32F2X is not set
# CONFIG_SOC_SERIES_STM32F3X is not set
# CONFIG_SOC_SERIES_STM32F4X is not set
# CONFIG_SOC_SERIES_STM32F7X is not set
# CONFIG_SOC_SERIES_STM32L0X is not set
# CONFIG_SOC_SERIES_STM32L4X is not set
# CONFIG_SOC_TI_LM3S6965 is not set
# CONFIG_SOC_SERIES_CC2650 is not set
# CONFIG_SOC_SERIES_CC32XX is not set
# CONFIG_SOC_SERIES_MSP432P4XX is not set

#
# ARM Options
#
CONFIG_ARCH_DEFCONFIG="arch/arm/defconfig"
CONFIG_CPU_CORTEX=y
CONFIG_CPU_CORTEX_M=y

#
# Architecture Floating Point Options
#
CONFIG_CPU_CORTEX_M4=y
CONFIG_ISA_THUMB2=y
CONFIG_CPU_CORTEX_M_HAS_BASEPRI=y
CONFIG_CPU_CORTEX_M_HAS_VTOR=y
CONFIG_CPU_CORTEX_M_HAS_PROGRAMMABLE_FAULT_PRIOS=y
CONFIG_ARMV7_M_ARMV8_M_MAINLINE=y
CONFIG_ARMV7_M_ARMV8_M_FP=y

#
# ARM Cortex-M options
#
CONFIG_LDREX_STREX_AVAILABLE=y
CONFIG_DATA_ENDIANNESS_LITTLE=y
CONFIG_STACK_ALIGN_DOUBLE_WORD=y
# CONFIG_RUNTIME_NMI is not set
CONFIG_FAULT_DUMP=2
CONFIG_XIP=y

#
# ARM Cortex-M0/M0+/M3/M4/M7/M23/M33 options
#
# CONFIG_ZERO_LATENCY_IRQS is not set
# CONFIG_PLATFORM_SPECIFIC_INIT is not set
CONFIG_ARM_CORE_MPU=y
# CONFIG_MPU_STACK_GUARD is not set
CONFIG_ARM_MPU=y
# CONFIG_MPU_ALLOW_FLASH_WRITE is not set

#
# SoC Configuration
#
CONFIG_SOC_FAMILY_NRF=y
CONFIG_HAS_HW_NRF_CCM=y
CONFIG_HAS_HW_NRF_CLOCK=y
CONFIG_HAS_HW_NRF_COMP=y
CONFIG_HAS_HW_NRF_ECB=y
CONFIG_HAS_HW_NRF_EGU0=y
CONFIG_HAS_HW_NRF_EGU1=y
CONFIG_HAS_HW_NRF_EGU2=y
CONFIG_HAS_HW_NRF_EGU3=y
CONFIG_HAS_HW_NRF_EGU4=y
CONFIG_HAS_HW_NRF_EGU5=y
CONFIG_HAS_HW_NRF_GPIO0=y
CONFIG_HAS_HW_NRF_GPIOTE=y
CONFIG_HAS_HW_NRF_I2S=y
CONFIG_HAS_HW_NRF_LPCOMP=y
CONFIG_HAS_HW_NRF_MWU=y
CONFIG_HAS_HW_NRF_NFCT=y
CONFIG_HAS_HW_NRF_PDM=y
CONFIG_HAS_HW_NRF_POWER=y
CONFIG_HAS_HW_NRF_PPI=y
CONFIG_HAS_HW_NRF_PWM0=y
CONFIG_HAS_HW_NRF_PWM1=y
CONFIG_HAS_HW_NRF_PWM2=y
CONFIG_HAS_HW_NRF_QDEC=y
CONFIG_HAS_HW_NRF_RNG=y
CONFIG_HAS_HW_NRF_RTC0=y
CONFIG_HAS_HW_NRF_RTC1=y
CONFIG_HAS_HW_NRF_RTC2=y
CONFIG_HAS_HW_NRF_SAADC=y
CONFIG_HAS_HW_NRF_SPI0=y
CONFIG_HAS_HW_NRF_SPI1=y
CONFIG_HAS_HW_NRF_SPI2=y
CONFIG_HAS_HW_NRF_SPIM0=y
CONFIG_HAS_HW_NRF_SPIM1=y
CONFIG_HAS_HW_NRF_SPIM2=y
CONFIG_HAS_HW_NRF_SPIS0=y
CONFIG_HAS_HW_NRF_SPIS1=y
CONFIG_HAS_HW_NRF_SPIS2=y
CONFIG_HAS_HW_NRF_SWI0=y
CONFIG_HAS_HW_NRF_SWI1=y
CONFIG_HAS_HW_NRF_SWI2=y
CONFIG_HAS_HW_NRF_SWI3=y
CONFIG_HAS_HW_NRF_SWI4=y
CONFIG_HAS_HW_NRF_SWI5=y
CONFIG_HAS_HW_NRF_TEMP=y
CONFIG_HAS_HW_NRF_TIMER0=y
CONFIG_HAS_HW_NRF_TIMER1=y
CONFIG_HAS_HW_NRF_TIMER2=y
CONFIG_HAS_HW_NRF_TIMER3=y
CONFIG_HAS_HW_NRF_TIMER4=y
CONFIG_HAS_HW_NRF_TWI0=y
CONFIG_HAS_HW_NRF_TWI1=y
CONFIG_HAS_HW_NRF_TWIM0=y
CONFIG_HAS_HW_NRF_TWIM1=y
CONFIG_HAS_HW_NRF_TWIS0=y
CONFIG_HAS_HW_NRF_TWIS1=y
CONFIG_HAS_HW_NRF_UART0=y
CONFIG_HAS_HW_NRF_UARTE0=y
CONFIG_HAS_HW_NRF_WDT=y
CONFIG_SOC_NRF52832=y
# CONFIG_SOC_NRF52810_QFAA is not set
CONFIG_SOC_NRF52832_QFAA=y
# CONFIG_SOC_NRF52840_QIAA is not set
CONFIG_SOC_DCDC_NRF52X=y
CONFIG_ARM_MPU_NRF52X=y
# CONFIG_NFCT_PINS_AS_GPIOS is not set
CONFIG_GPIO_AS_PINRESET=y
CONFIG_NRF_ENABLE_ICACHE=y
CONFIG_BOARD_NRF52_PCA10040=y

#
# Board Options
#
CONFIG_BOARD_ENABLE_DCDC=y

#
# Shields
#

#
# General Kernel Options
#
CONFIG_MULTITHREADING=y
CONFIG_NUM_COOP_PRIORITIES=16
CONFIG_NUM_PREEMPT_PRIORITIES=15
CONFIG_MAIN_THREAD_PRIORITY=0
CONFIG_COOP_ENABLED=y
CONFIG_PREEMPT_ENABLED=y
CONFIG_PRIORITY_CEILING=0
CONFIG_NUM_METAIRQ_PRIORITIES=0
# CONFIG_SCHED_DEADLINE is not set
CONFIG_MAIN_STACK_SIZE=1024
CONFIG_IDLE_STACK_SIZE=320
CONFIG_ISR_STACK_SIZE=2048
CONFIG_THREAD_STACK_INFO=y
# CONFIG_THREAD_CUSTOM_DATA is not set
CONFIG_ERRNO=y
# CONFIG_APPLICATION_MEMORY is not set
CONFIG_SCHED_DUMB=y
# CONFIG_SCHED_SCALABLE is not set
# CONFIG_SCHED_MULTIQ is not set
# CONFIG_WAITQ_SCALABLE is not set
CONFIG_WAITQ_DUMB=y

#
# Kernel Debugging and Metrics
#
# CONFIG_INIT_STACKS is not set
# CONFIG_KERNEL_DEBUG is not set
CONFIG_BOOT_BANNER=y
CONFIG_BOOT_DELAY=0
# CONFIG_BUILD_TIMESTAMP is not set
# CONFIG_EXECUTION_BENCHMARKING is not set
# CONFIG_THREAD_MONITOR is not set

#
# Work Queue Options
#
CONFIG_SYSTEM_WORKQUEUE_STACK_SIZE=1024
CONFIG_SYSTEM_WORKQUEUE_PRIORITY=-1
CONFIG_OFFLOAD_WORKQUEUE_STACK_SIZE=1024
CONFIG_OFFLOAD_WORKQUEUE_PRIORITY=-1

#
# Atomic Operations
#
CONFIG_ATOMIC_OPERATIONS_BUILTIN=y

#
# Timer API Options
#
CONFIG_TIMESLICING=y
CONFIG_TIMESLICE_SIZE=0
CONFIG_TIMESLICE_PRIORITY=0
CONFIG_POLL=y

#
# Other Kernel Object Options
#
CONFIG_NUM_MBOX_ASYNC_MSGS=10
CONFIG_NUM_PIPE_ASYNC_MSGS=10
CONFIG_HEAP_MEM_POOL_SIZE=0
CONFIG_ARCH_HAS_CUSTOM_SWAP_TO_MAIN=y
CONFIG_SYS_CLOCK_TICKS_PER_SEC=100
CONFIG_SYS_CLOCK_HW_CYCLES_PER_SEC=32768
CONFIG_SYS_CLOCK_EXISTS=y

#
# Initialization Priorities
#
CONFIG_KERNEL_INIT_PRIORITY_OBJECTS=30
CONFIG_KERNEL_INIT_PRIORITY_DEFAULT=40
CONFIG_KERNEL_INIT_PRIORITY_DEVICE=50
CONFIG_APPLICATION_INIT_PRIORITY=90

#
# Security Options
#
CONFIG_RETPOLINE=y
# CONFIG_STACK_CANARIES is not set
CONFIG_STACK_POINTER_RANDOM=0

#
# SMP Options
#
# CONFIG_USE_SWITCH is not set
# CONFIG_SMP is not set
CONFIG_MP_NUM_CPUS=1
# CONFIG_KERNEL_EVENT_LOGGER is not set
CONFIG_SYS_POWER_MANAGEMENT=y
# CONFIG_SYS_POWER_LOW_POWER_STATE is not set
# CONFIG_SYS_POWER_DEEP_SLEEP is not set
# CONFIG_DEVICE_POWER_MANAGEMENT is not set
CONFIG_TICKLESS_IDLE=y
CONFIG_TICKLESS_IDLE_THRESH=3
# CONFIG_TICKLESS_KERNEL is not set
# CONFIG_BUSY_WAIT_USES_ALTERNATE_CLOCK is not set
CONFIG_HAS_DTS=y
CONFIG_HAS_DTS_GPIO=y
CONFIG_HAS_DTS_I2C=y

#
# Device Drivers
#
# CONFIG_IEEE802154 is not set
CONFIG_CONSOLE=y
CONFIG_CONSOLE_INPUT_MAX_LINE_LEN=128
CONFIG_CONSOLE_HAS_DRIVER=y
# CONFIG_CONSOLE_HANDLER is not set
CONFIG_UART_CONSOLE=y
CONFIG_UART_CONSOLE_INIT_PRIORITY=60
# CONFIG_UART_CONSOLE_DEBUG_SERVER_HOOKS is not set
# CONFIG_UART_CONSOLE_MCUMGR is not set
# CONFIG_USB_UART_CONSOLE is not set
# CONFIG_RAM_CONSOLE is not set
CONFIG_RTT_CONSOLE=y
CONFIG_RTT_TX_RETRY_CNT=2
CONFIG_RTT_TX_RETRY_DELAY_MS=2
# CONFIG_RTT_TX_RETRY_IN_INTERRUPT is not set
# CONFIG_IPM_CONSOLE_SENDER is not set
# CONFIG_IPM_CONSOLE_RECEIVER is not set
# CONFIG_UART_PIPE is not set
# CONFIG_UART_MCUMGR is not set
# CONFIG_TELNET_CONSOLE is not set
# CONFIG_WEBSOCKET_CONSOLE is not set

#
# Ethernet Drivers
#
# CONFIG_SLIP is not set
# CONFIG_NET_LOOPBACK is not set
CONFIG_SERIAL=y

#
# Capabilities
#
CONFIG_SERIAL_HAS_DRIVER=y
CONFIG_SERIAL_SUPPORT_INTERRUPT=y
# CONFIG_UART_INTERRUPT_DRIVEN is not set
# CONFIG_UART_LINE_CTRL is not set
# CONFIG_UART_DRV_CMD is not set

#
# Serial Drivers
#
# CONFIG_UART_NS16550 is not set
# CONFIG_UART_STELLARIS is not set
# CONFIG_UART_NSIM is not set
CONFIG_UART_NRFX=y
CONFIG_UART_0_NRF_UART=y
# CONFIG_UART_0_NRF_PARITY_BIT is not set
# CONFIG_UART_0_NRF_FLOW_CONTROL is not set
CONFIG_UART_0_NRF_TX_PIN=6
CONFIG_UART_0_NRF_RX_PIN=8
CONFIG_UART_0_NRF_CTS_PIN=7
CONFIG_UART_0_NRF_RTS_PIN=5
CONFIG_NRF_UART_PERIPHERAL=y
# CONFIG_UART_ALTERA_JTAG is not set

#
# Interrupt Controllers
#
# CONFIG_MULTI_LEVEL_INTERRUPTS is not set

#
# Timer Drivers
#
CONFIG_NRF_RTC_TIMER=y
# CONFIG_SYSTEM_CLOCK_DISABLE is not set
# CONFIG_TIMER_READS_ITS_FREQUENCY_AT_RUNTIME is not set
CONFIG_SYSTEM_CLOCK_INIT_PRIORITY=0
CONFIG_ENTROPY_GENERATOR=y
CONFIG_ENTROPY_NRF5_RNG=y
CONFIG_ENTROPY_NRF5_BIAS_CORRECTION=y
CONFIG_ENTROPY_NRF5_THR_THRESHOLD=4
CONFIG_ENTROPY_NRF5_ISR_THRESHOLD=12
CONFIG_ENTROPY_NRF5_THR_BUF_LEN=4
CONFIG_ENTROPY_NRF5_ISR_BUF_LEN=12
CONFIG_ENTROPY_NRF5_PRI=5
CONFIG_ENTROPY_HAS_DRIVER=y
CONFIG_ENTROPY_NAME="ENTROPY_0"
# CONFIG_GROVE is not set
CONFIG_GPIO=y
# CONFIG_GPIO_DW is not set
# CONFIG_GPIO_PCAL9535A is not set
# CONFIG_GPIO_SCH is not set
CONFIG_GPIO_NRF5=y
CONFIG_GPIO_NRF5_INIT_PRIORITY=40
CONFIG_GPIO_NRF5_P0=y
# CONFIG_GPIO_SX1509B is not set
CONFIG_GPIO_SX1509B_INIT_PRIORITY=70
CONFIG_GPIO_SX1509B_DEV_NAME="GPIO_P0"
CONFIG_GPIO_SX1509B_I2C_ADDR=0x3e
CONFIG_GPIO_SX1509B_I2C_MASTER_DEV_NAME=""
# CONFIG_SHARED_IRQ is not set
# CONFIG_SPI is not set
CONFIG_I2C=y
CONFIG_I2C_INIT_PRIORITY=60
CONFIG_I2C_0=y
# CONFIG_I2C_1 is not set
# CONFIG_I2C_2 is not set
# CONFIG_I2C_3 is not set
# CONFIG_I2C_4 is not set
# CONFIG_I2C_DW is not set
# CONFIG_I2C_SLAVE is not set
# CONFIG_I2C_GPIO is not set
CONFIG_I2C_NRFX=y
CONFIG_I2C_0_NRF_TWI=y
# CONFIG_I2C_0_NRF_TWIM is not set
# CONFIG_I2C_SBCON is not set
# CONFIG_I2S is not set
# CONFIG_PWM is not set
# CONFIG_PINMUX is not set
# CONFIG_ADC is not set
# CONFIG_RTC is not set
# CONFIG_WATCHDOG is not set
CONFIG_CLOCK_CONTROL=y
CONFIG_CLOCK_CONTROL_NRF5=y
CONFIG_CLOCK_CONTROL_NRF5_IRQ_PRIORITY=1
CONFIG_CLOCK_CONTROL_NRF5_M16SRC_DRV_NAME="clk_m16src"
CONFIG_CLOCK_CONTROL_NRF5_K32SRC_DRV_NAME="clk_k32src"
# CONFIG_CLOCK_CONTROL_NRF5_K32SRC_RC is not set
CONFIG_CLOCK_CONTROL_NRF5_K32SRC_XTAL=y
# CONFIG_CLOCK_CONTROL_NRF5_K32SRC_500PPM is not set
# CONFIG_CLOCK_CONTROL_NRF5_K32SRC_250PPM is not set
# CONFIG_CLOCK_CONTROL_NRF5_K32SRC_150PPM is not set
# CONFIG_CLOCK_CONTROL_NRF5_K32SRC_100PPM is not set
# CONFIG_CLOCK_CONTROL_NRF5_K32SRC_75PPM is not set
# CONFIG_CLOCK_CONTROL_NRF5_K32SRC_50PPM is not set
# CONFIG_CLOCK_CONTROL_NRF5_K32SRC_30PPM is not set
CONFIG_CLOCK_CONTROL_NRF5_K32SRC_20PPM=y
# CONFIG_CLOCK_CONTROL_QUARK_SE is not set
# CONFIG_PTP_CLOCK is not set
# CONFIG_IPM is not set
# CONFIG_AIO_COMPARATOR is not set
# CONFIG_FLASH is not set
CONFIG_SENSOR=y
CONFIG_SENSOR_INIT_PRIORITY=90

#
# Device Drivers
#
# CONFIG_AK8975 is not set
# CONFIG_AMG88XX is not set
# CONFIG_APDS9960 is not set
# CONFIG_BMA280 is not set
# CONFIG_BMC150_MAGN is not set
# CONFIG_BME280 is not set
# CONFIG_BMG160 is not set
# CONFIG_BMM150 is not set
# CONFIG_CCS811 is not set
# CONFIG_DHT is not set
# CONFIG_FXAS21002 is not set
# CONFIG_FXOS8700 is not set
# CONFIG_HDC1008 is not set
# CONFIG_HMC5883L is not set
# CONFIG_HP206C is not set
# CONFIG_HTS221 is not set
# CONFIG_ISL29035 is not set
# CONFIG_LIS2DH is not set
# CONFIG_LIS3DH is not set
# CONFIG_LIS3MDL is not set
# CONFIG_LPS22HB is not set
# CONFIG_LPS25HB is not set
# CONFIG_LSM6DS0 is not set
# CONFIG_LSM6DSL is not set
# CONFIG_LSM9DS0_GYRO is not set
# CONFIG_LSM9DS0_MFD is not set
# CONFIG_MAX30101 is not set
# CONFIG_MAX44009 is not set
# CONFIG_MCP9808 is not set
# CONFIG_MPU6050 is not set
CONFIG_TEMP_NRF5=y
CONFIG_TEMP_NRF5_NAME="TEMP_0"
CONFIG_TEMP_NRF5_PRI=1
# CONFIG_PMS7003 is not set
# CONFIG_SHT3XD is not set
# CONFIG_SX9500 is not set
# CONFIG_TH02 is not set
# CONFIG_TMP007 is not set
# CONFIG_TMP112 is not set
# CONFIG_VL53L0X is not set
# CONFIG_COUNTER is not set
# CONFIG_DMA is not set
# CONFIG_USB is not set
# CONFIG_CRYPTO is not set
# CONFIG_DISPLAY is not set
# CONFIG_LED_STRIP is not set
# CONFIG_WIFI is not set
# CONFIG_LED is not set
# CONFIG_CAN is not set

#
# Build and Link Features
#

#
# Linker Options
#
CONFIG_HAS_FLASH_LOAD_OFFSET=y
CONFIG_TEXT_SECTION_OFFSET=0
# CONFIG_HAVE_CUSTOM_LINKER_SCRIPT is not set
# CONFIG_CUSTOM_RODATA_LD is not set
# CONFIG_CUSTOM_RWDATA_LD is not set
# CONFIG_CUSTOM_SECTIONS_LD is not set
# CONFIG_LINK_WHOLE_ARCHIVE is not set
CONFIG_KERNEL_ENTRY="__start"
CONFIG_CHECK_LINK_MAP=y

#
# Compiler Options
#
CONFIG_CROSS_COMPILE=""
# CONFIG_NATIVE_APPLICATION is not set
CONFIG_SIZE_OPTIMIZATIONS=y
# CONFIG_SPEED_OPTIMIZATIONS is not set
# CONFIG_DEBUG_OPTIMIZATIONS is not set
# CONFIG_NO_OPTIMIZATIONS is not set
CONFIG_COMPILER_OPT=""
# CONFIG_CPLUSPLUS is not set

#
# Build Options
#
CONFIG_KERNEL_BIN_NAME="zephyr"
CONFIG_OUTPUT_STAT=y
CONFIG_OUTPUT_DISASSEMBLY=y
CONFIG_OUTPUT_PRINT_MEMORY_USAGE=y
CONFIG_BUILD_OUTPUT_HEX=y
CONFIG_BUILD_OUTPUT_BIN=y
# CONFIG_BUILD_OUTPUT_EXE is not set
# CONFIG_BUILD_OUTPUT_S19 is not set
# CONFIG_BUILD_OUTPUT_STRIPPED is not set

#
# System Monitoring Options
#
# CONFIG_PERFORMANCE_METRICS is not set
# CONFIG_STATS is not set

#
# Boot Options
#
# CONFIG_IS_BOOTLOADER is not set
# CONFIG_BOOTLOADER_MCUBOOT is not set
# CONFIG_REBOOT is not set

#
# C Library
#
# CONFIG_NEWLIB_LIBC is not set
# CONFIG_STDOUT_CONSOLE is not set

#
# Additional libraries
#
# CONFIG_JSON_LIBRARY is not set
# CONFIG_RING_BUFFER is not set
# CONFIG_BASE64 is not set
# CONFIG_PTHREAD_IPC is not set

#
# Bluetooth
#
CONFIG_BT=y
CONFIG_BT_HCI=y
# CONFIG_BT_CUSTOM is not set
# CONFIG_BT_HCI_RAW is not set
# CONFIG_BT_PERIPHERAL is not set
# CONFIG_BT_CENTRAL is not set

#
# Broadcaster
#
CONFIG_BT_BROADCASTER=y

#
# Observer
#
# CONFIG_BT_OBSERVER is not set
CONFIG_BT_HCI_VS_EXT=y
CONFIG_BT_DEBUG_NONE=y
# CONFIG_BT_DEBUG_LOG is not set
# CONFIG_BT_DEBUG_MONITOR is not set

#
# Host Stack Configuration
#
CONFIG_BT_HCI_HOST=y
CONFIG_BT_HCI_CMD_COUNT=2
CONFIG_BT_RX_BUF_COUNT=3
CONFIG_BT_RX_BUF_LEN=76
CONFIG_BT_HCI_TX_STACK_SIZE=640
CONFIG_BT_HCI_TX_PRIO=7
# CONFIG_BT_WAIT_NOP is not set
CONFIG_BT_HCI_RESERVE=0
CONFIG_BT_RECV_IS_RX_THREAD=y
CONFIG_BT_RX_STACK_SIZE=1024
CONFIG_BT_RX_PRIO=8
CONFIG_BT_DEVICE_NAME="Zephyr"
CONFIG_BT_DEVICE_APPEARANCE=0
# CONFIG_BT_TINYCRYPT_ECC is not set
# CONFIG_BT_TESTING is not set
# CONFIG_BT_BREDR is not set

#
# BLE Controller support
#
CONFIG_BT_CTLR=y
CONFIG_BT_LL_SW=y

#
# BLE Controller configuration
#
CONFIG_BT_CTLR_CRYPTO=y
CONFIG_BT_CTLR_RX_PRIO_STACK_SIZE=448
CONFIG_BT_CTLR_RX_PRIO=6
CONFIG_BT_CTLR_FILTER=y
CONFIG_BT_CTLR_HCI_VS_BUILD_INFO=""
CONFIG_BT_CTLR_RX_BUFFERS=1
CONFIG_BT_CTLR_TX_BUFFERS=2
CONFIG_BT_CTLR_TX_BUFFER_SIZE=27
# CONFIG_BT_CTLR_TX_PWR_PLUS_4 is not set
# CONFIG_BT_CTLR_TX_PWR_PLUS_3 is not set
CONFIG_BT_CTLR_TX_PWR_0=y
# CONFIG_BT_CTLR_TX_PWR_MINUS_4 is not set
# CONFIG_BT_CTLR_TX_PWR_MINUS_8 is not set
# CONFIG_BT_CTLR_TX_PWR_MINUS_12 is not set
# CONFIG_BT_CTLR_TX_PWR_MINUS_16 is not set
# CONFIG_BT_CTLR_TX_PWR_MINUS_20 is not set
# CONFIG_BT_CTLR_TX_PWR_MINUS_40 is not set
CONFIG_BT_CTLR_COMPANY_ID=0x05F1
CONFIG_BT_CTLR_SUBVERSION_NUMBER=0xFFFF

#
# BLE Controller features
#
CONFIG_BT_CTLR_CHAN_SEL_2=y
CONFIG_BT_CTLR_MIN_USED_CHAN=y
CONFIG_BT_CTLR_ADV_EXT=y
# CONFIG_BT_CTLR_DTM_HCI is not set
# CONFIG_BT_CTLR_ADVANCED_FEATURES is not set
CONFIG_BT_CTLR_WORKER_PRIO=0
CONFIG_BT_CTLR_JOB_PRIO=0
CONFIG_BT_CTLR_XTAL_ADVANCED=y
CONFIG_BT_CTLR_XTAL_THRESHOLD=1500
CONFIG_BT_CTLR_SCHED_ADVANCED=y
CONFIG_BT_CTLR_RADIO_ENABLE_FAST=y
CONFIG_BT_CTLR_SCAN_REQ_NOTIFY=y

#
# BLE Controller hardware configuration
#
# CONFIG_BT_CTLR_GPIO_PA is not set
# CONFIG_BT_CTLR_GPIO_LNA is not set

#
# BLE Controller debug configuration
#
# CONFIG_BT_CTLR_PROFILE_ISR is not set
# CONFIG_BT_CTLR_DEBUG_PINS is not set
# CONFIG_BT_SHELL is not set

#
# Console
#
# CONFIG_CONSOLE_SUBSYS is not set

#
# Debugging Options
#
# CONFIG_DEBUG is not set
# CONFIG_STACK_USAGE is not set
# CONFIG_STACK_SENTINEL is not set
CONFIG_PRINTK=y
CONFIG_EARLY_CONSOLE=y
# CONFIG_ASSERT is not set
# CONFIG_FORCE_NO_ASSERT is not set
# CONFIG_OBJECT_TRACING is not set
# CONFIG_OVERRIDE_FRAME_POINTER_DEFAULT is not set
# CONFIG_DEBUG_INFO is not set
# CONFIG_OPENOCD_SUPPORT is not set

#
# Disk
#
# CONFIG_DISK_ACCESS is not set
CONFIG_DISK_ACCESS_MAX_VOLUMES=8

#
# File Systems
#
# CONFIG_FILE_SYSTEM is not set
# CONFIG_NVS is not set

#
# Logging Options
#
# CONFIG_SYS_LOG is not set
# CONFIG_LOG is not set

#
# Management
#
# CONFIG_MCUMGR_SMP_BT is not set
# CONFIG_MCUMGR_SMP_SHELL is not set
# CONFIG_MCUMGR_SMP_UART is not set
CONFIG_MCUMGR_BUF_COUNT=4
CONFIG_MCUMGR_BUF_SIZE=384
CONFIG_MCUMGR_BUF_USER_DATA_SIZE=4

#
# Networking
#
CONFIG_NET_BUF=y
CONFIG_NET_BUF_USER_DATA_SIZE=4
# CONFIG_NET_BUF_LOG is not set
# CONFIG_NET_BUF_POOL_USAGE is not set
# CONFIG_NETWORKING is not set
# CONFIG_CONSOLE_SHELL is not set

#
# DFU options
#
# CONFIG_IMG_MANAGER is not set
CONFIG_ENTROPY_DEVICE_RANDOM_GENERATOR=y
# CONFIG_XOROSHIRO_RANDOM_GENERATOR is not set

#
# Storage
#

#
# External Sources
#

#
# HALs
#
CONFIG_HAS_CMSIS=y
# CONFIG_LIBMETAL is not set
CONFIG_LIBMETAL_SRC_PATH="libmetal"
CONFIG_HAS_NRFX=y
CONFIG_NRFX_TWI=y

#
# Cryptography
#
# CONFIG_TINYCRYPT is not set
# CONFIG_MBEDTLS is not set

#
# Encoding
#
# CONFIG_TINYCBOR is not set
# CONFIG_OPENAMP is not set
CONFIG_OPENAMP_SRC_PATH="open-amp"

#
# Management
#
# CONFIG_MCUMGR is not set

#
# Debug libraries
#
CONFIG_HAS_SEGGER_RTT=y
# CONFIG_SEGGER_SYSTEMVIEW is not set
CONFIG_SEGGER_RTT_MAX_NUM_UP_BUFFERS=3
CONFIG_SEGGER_RTT_MAX_NUM_DOWN_BUFFERS=3
CONFIG_SEGGER_RTT_BUFFER_SIZE_UP=1024
CONFIG_SEGGER_RTT_BUFFER_SIZE_DOWN=16
CONFIG_SEGGER_RTT_PRINTF_BUFFER_SIZE=64
CONFIG_SEGGER_RTT_MODE_NO_BLOCK_SKIP=y
# CONFIG_SEGGER_RTT_MODE_NO_BLOCK_TRIM is not set
# CONFIG_SEGGER_RTT_MODE_BLOCK_IF_FIFO_FULL is not set
CONFIG_SEGGER_RTT_MODE=0
# CONFIG_SEGGER_RTT_MEMCPY_USE_BYTELOOP is not set

#
# Testing
#
# CONFIG_ZTEST is not set
# CONFIG_TEST is not set
CONFIG_TEST_EXTRA_STACKSIZE=0
CONFIG_NUM_IRQS=39
```

## src/main.c
```c
#include <errno.h>
#include <zephyr.h>
#include <misc/printk.h>
#include <device.h>
#include <sensor.h>
#include <i2c.h>
#include <stdio.h>
#include "imu.h"
#include "temperature.h"
#include "ui.h"
#include "bt.h"

#include "nrf52.h"

#define IMU_TASK_STACK_SIZE (2048)
K_THREAD_STACK_DEFINE(imu_task_stack, IMU_TASK_STACK_SIZE);
static struct k_thread imu_data;

#define TEMPERATURE_TASK_STACK_SIZE (2048)
K_THREAD_STACK_DEFINE(temperature_task_stack, TEMPERATURE_TASK_STACK_SIZE);
static struct k_thread temperature_data;

#define UI_TASK_STACK_SIZE (2048)
K_THREAD_STACK_DEFINE(ui_task_stack, UI_TASK_STACK_SIZE);
static struct k_thread ui_data;

#define BLUETOOTH_TASK_STACK_SIZE (2048)
K_THREAD_STACK_DEFINE(bluetooth_task_stack, BLUETOOTH_TASK_STACK_SIZE);
static struct k_thread bluetooth_data;

void main(void)
{
	// Disable pin reset
	/*NRF_UICR->PSELRESET[0] = 0x0;
	NRF_UICR->PSELRESET[1] = 0x1;*/

	k_thread_create(&temperature_data, 						
					temperature_task_stack,					// Data buffer for thread stack
					TEMPERATURE_TASK_STACK_SIZE,			// Thread stack size 
					(k_thread_entry_t) temperature_task, 	// Thread function
					NULL, 									// Parameter 1
					NULL, 									// Parameter 2
					NULL, 									// Parameter 3
					K_PRIO_PREEMPT(7),					    // Thread priority 
					0, 										// Thread options
					K_NO_WAIT);								// Scheduling delay

	k_thread_create(&imu_data, 						
					imu_task_stack,							// Data buffer for thread stack
					IMU_TASK_STACK_SIZE,					// Thread stack size 
					(k_thread_entry_t) imu_task, 			// Thread function
					NULL, 									// Parameter 1
					NULL, 									// Parameter 2
					NULL, 									// Parameter 3
					K_PRIO_COOP(1),							// Thread priority 
					0, 										// Thread options
					K_NO_WAIT);								// Scheduling delay

/*
	k_thread_create(&ui_data, 						
					ui_task_stack,							// Data buffer for thread stack
					UI_TASK_STACK_SIZE,						// Thread stack size 
					(k_thread_entry_t) ui_task, 			// Thread function
					NULL, 									// Parameter 1
					NULL, 									// Parameter 2
					NULL, 									// Parameter 3
					K_PRIO_COOP(7),							// Thread priority 
					0, 										// Thread options
					K_NO_WAIT);								// Scheduling delay
*/

	k_thread_create(&bluetooth_data, 						
					bluetooth_task_stack,					// Data buffer for thread stack
					BLUETOOTH_TASK_STACK_SIZE,			    // Thread stack size 
					(k_thread_entry_t) bluetooth_task,   	// Thread function
					NULL, 									// Parameter 1
					NULL, 									// Parameter 2
					NULL, 									// Parameter 3
					K_PRIO_PREEMPT(7),					    // Thread priority 
					0, 										// Thread options
					K_NO_WAIT);								// Scheduling delay

}
```

## src/bt.c
```c
// System includes
#include <zephyr.h>
#include <bluetooth/bluetooth.h>
#include <bluetooth/conn.h>
#include <bluetooth/uuid.h>
#include <bluetooth/gatt.h>
#include <misc/byteorder.h>
#include <stdio.h>

// Application includes
#include "messages.h"
#include "hog_parser.h"
#include "bt.h"

//
// Private function definitions
//

static void bt_ready(int err);
static void start_bt_le_scan();
static BT_DEVICE* get_empty_device_list_slot();
static void initialize_device_list();
static bool is_address_in_device_list(const bt_addr_le_t* addr);
static void pair_device(BT_DEVICE* device);
static void device_connected(struct bt_conn *conn, u8_t err);
static void device_disconnected(struct bt_conn *conn, u8_t reason);
static u8_t gatt_notify_cb(struct bt_conn *conn,
			   struct bt_gatt_subscribe_params *params,
			   const void *data, u16_t length);
static u8_t gatt_discover_cb(struct bt_conn *conn,
			     const struct bt_gatt_attr *attr,
			     struct bt_gatt_discover_params *params);
static u8_t gatt_read_cb(struct bt_conn *conn, u8_t err,
			 struct bt_gatt_read_params *params,
			 const void *data, u16_t length);

//
// Public variable declarations
//
BT_DEVICE_LIST g_device_list;

//
// Private variable declarations
//
static struct bt_conn_cb bt_conn_callbacks = {
		.connected = device_connected,
		.disconnected = device_disconnected,
};

// TODO: robustify BT connection management, potentially allow multiple connections?
static struct bt_conn *default_conn;

static struct bt_uuid_16 uuid = BT_UUID_INIT_16(0);
static struct bt_gatt_discover_params discover_params;
static struct bt_gatt_subscribe_params subscribe_params;
static struct bt_gatt_read_params read_params;

#define HOGP_TASK_STACK_SIZE (2048)
K_THREAD_STACK_DEFINE(hogp_task_stack, HOGP_TASK_STACK_SIZE);
static struct k_thread hogp_data;

//
// Public function declarations
//

void bluetooth_task(void *arg1, void *arg2, void *arg3)
{
    int err;

    printf("Starting Bluetooth task\r\n");

	// Initialize the Bluetooth Subsystem
	err = bt_enable(bt_ready);
	if (err) {
		printf("Bluetooth init failed (err %d)\r\n", err);
		return;
	}

	bt_conn_cb_register(&bt_conn_callbacks);

	initialize_device_list();

	BLUETOOTH_TASK_MESSAGE message;

    while(true)
    {
		k_msgq_get(&bluetooth_task_queue, &message, K_FOREVER);

		switch((BLUETOOTH_TASK_COMMAND) message.command)
		{
			case BLUETOOTH_READY:
				printf("Bluetooth ready\r\n");
				break;

			case BLUETOOTH_START_SCAN:
				printf("Starting BLE Scan...\r\n");
				start_bt_le_scan();
				break;

			case BLUETOOTH_STOP_SCAN:
				break;

			case BLUETOOTH_PAIR_DEVICE:
				pair_device(message.device);
				break;

			default:
				__ASSERT(false, "Invalid Bluetooth Task command received");
		}
    }
}

// Convenience function to take the global device list lock
void take_device_list_lock()
{
	k_mutex_lock(&g_device_list.lock, K_FOREVER);
}

// Convenience function to release the global device list lock
void release_device_list_lock()
{
	k_mutex_unlock(&g_device_list.lock);
}

//
// Private function declarations
//

void bt_ready(int err)
{
	if (err) {
		printf("Bluetooth init failed (err %d)\r\n", err);
		return;
	}

	BLUETOOTH_TASK_MESSAGE message;
	message.command = BLUETOOTH_READY;

	while (k_msgq_put(&bluetooth_task_queue, &message, K_NO_WAIT) != 0) 
	{
		// message queue is full: purge old data & try again
		k_msgq_purge(&bluetooth_task_queue);
	}

	printf("Bluetooth initialized\r\n");
}

/*

Steam Controller advertisement looks like this:

[DEVICE]: ff:c1:22:f6:ae:dc (random), AD evt type 0, AD data len 28, RSSI -33
        [AD]: 25 data_len 2                    -> BT_DATA_GAP_APPEARANCE
        [AD]: 1 data_len 1					   -> BT_DATA_FLAGS
        [AD]: 2 data_len 2					   -> BT_DATA_UUID16_SOME	
        [AD]: UUID16 FOUND - 6162			   -> BT_UUID_HIDS
        [AD]: 9 data_len 15					   -> BT_DATA_NAME_COMPLETE
        [AD]: NAME FOUND - SteamController ▒D
*/

static bool bt_data_parse_callback(struct bt_data* data, void* user_data)
{
	BT_DEVICE *device = user_data;

	//printf("\t[AD]: %u data_len %u\r\n", data->type, data->data_len);

	switch (data->type) 
	{
		case BT_DATA_UUID16_SOME:
		case BT_DATA_UUID16_ALL:
			if (data->data_len % sizeof(u16_t) != 0) 
			{
				//printf("AD malformed\r\n");
				return true;
			}

			for (int i = 0; i < data->data_len; i += sizeof(u16_t)) 
			{
				struct bt_uuid *uuid;
				u16_t u16;

				memcpy(&u16, &data->data[i], sizeof(u16));
				u16 = sys_le16_to_cpu(u16);
				uuid = BT_UUID_DECLARE_16(u16);

				//printf("\t[AD]: UUID16 FOUND - %u\r\n", u16);

				if (bt_uuid_cmp(uuid, BT_UUID_HIDS) == 0)
				{
					device->is_hid_device = true;
				}
			}
			break;

		case BT_DATA_NAME_COMPLETE:
		case BT_DATA_NAME_SHORTENED:	
			memcpy(device->name, data->data, min(data->data_len, BT_MAX_NAME_LEN - 1));
			//printf("\t[AD]: NAME FOUND - %s\r\n", device->name);
			break;		
	}

	return true;
}

static void bt_le_scan_callback(const bt_addr_le_t* addr, int8_t rssi, uint8_t adv_type, struct net_buf_simple* buf)
{
	BT_DEVICE device = {0};

	// We're only interested in connectable events
	if (adv_type == BT_LE_ADV_IND || adv_type == BT_LE_ADV_DIRECT_IND)
	{
		memcpy(&device.address, addr, sizeof(bt_addr_le_t));

		bt_data_parse(buf, bt_data_parse_callback, (void *)&device);

		// If we detected that this is a HID device and it has a name,
		// we will add it to the list of pair-able devices
		if (device.is_hid_device && device.name[0] != '\0')
		{		   
			// Must take the device list lock before reading or writing
			// Must hold the lock while making modifications (like populating a cell)
			take_device_list_lock();
			{
				// Do nothing if this is a duplicate advertisement
				if (!is_address_in_device_list(addr))
				{
					// Copy our local device data into a slot in the global device structure
					BT_DEVICE* empty_slot = get_empty_device_list_slot();

					if (empty_slot != NULL)
					{
						// Mark the device as valid and copy to the destination buffer
						device.is_valid = true;
						memcpy(empty_slot, &device, sizeof(BT_DEVICE));
					}
					else
					{
						printf("WARNING: bluetooth device list is full. Cannot add new device\r\n");
					}
				}
			}
			release_device_list_lock();

			// Announce that the discovered device list has changed
			UI_TASK_MESSAGE message;
			message.command = UI_BT_DEVICE_LIST_UPDATED;

			while (k_msgq_put(&ui_task_queue, &message, K_NO_WAIT) != 0)
			{
				// message queue is full: purge old data & try again
				k_msgq_purge(&ui_task_queue);
			}
		}
	}
}

void start_bt_le_scan()
{
	int err;
	err = bt_le_scan_start(BT_LE_SCAN_ACTIVE, bt_le_scan_callback);

	if (err == 0)
	{
		printf("Bluetooth device discovery started\r\n");
	}
	else
	{
		printf("Bluetooth device discovery failed to start: err %d\r\n", err);
	}
}

static void pair_device(BT_DEVICE* device)
{
	// Stop BT LE scanning
	int status = bt_le_scan_stop();

	if (status == -EALREADY)
	{
		printf("WARN: Odd state. Attempted to pair to device while not in BT LE scan mode\r\n");
	}
	else if (status != 0)
	{
		printf("WARN: Unknown error while stopping BT LE Scan. Err = %d\r\n", status);
	}

	default_conn = bt_conn_create_le(&device->address, BT_LE_CONN_PARAM_DEFAULT);
}

static void device_connected(struct bt_conn *conn, u8_t err)
{
	char addr[BT_ADDR_LE_STR_LEN];

	bt_addr_le_to_str(bt_conn_get_dst(conn), addr, sizeof(addr));

	if (err) {
		printf("Failed to connect to %s (%u)\r\n", addr, err);
		return;
	}

	if (conn != default_conn) 
	{
		printf("WARNING: connected to device, but bt_conn does not match global connection\r\n");
		return;
	}

	printf("Connected: %s\r\n", addr);

	// Create the HOG Parser task to go and perform the parsing of this device's
	// HID-over-GATT profile (if it exists...)
	k_thread_create(&hogp_data, 						
					hogp_task_stack,						// Data buffer for thread stack
					HOGP_TASK_STACK_SIZE,			    	// Thread stack size 
					(k_thread_entry_t) hog_parser_task,   	// Thread function
					default_conn, 							// Parameter 1
					NULL, 									// Parameter 2
					NULL, 									// Parameter 3
					K_PRIO_COOP(7),							// Thread priority 
					0, 										// Thread options
					K_NO_WAIT);								// Scheduling delay

	// Discover HID services on the connected device
	/*memcpy(&uuid, BT_UUID_HIDS, sizeof(uuid));
		discover_params.uuid = &uuid.uuid;
		discover_params.func = gatt_discover_cb;
		discover_params.start_handle = 0x0001;
		discover_params.end_handle = 0xffff;
		discover_params.type = BT_GATT_DISCOVER_PRIMARY;

	int status = bt_gatt_discover(default_conn, &discover_params);
	if (status) {
		printk("Discover failed (err %d)\r\n", status);
	}*/
}

static void device_disconnected(struct bt_conn *conn, u8_t reason)
{
	char addr[BT_ADDR_LE_STR_LEN];

	if (conn != default_conn) {
		return;
	}

	bt_addr_le_to_str(bt_conn_get_dst(conn), addr, sizeof(addr));

	printf("Disconnected: %s (reason %u)\r\n", addr, reason);

	bt_conn_unref(default_conn);
	default_conn = NULL;
}

/*
static u8_t gatt_notify_cb(struct bt_conn *conn,
			   struct bt_gatt_subscribe_params *params,
			   const void *data, u16_t length)
{
	if (!data) {
		printk("[UNSUBSCRIBED]\r\n");
		params->value_handle = 0;
		return BT_GATT_ITER_STOP;
	}

	printk("[NOTIFICATION] data %p length %u\r\n", data, length);

	return BT_GATT_ITER_CONTINUE;
}
*/
/*
static u8_t gatt_read_cb(struct bt_conn *conn, u8_t err,
			 struct bt_gatt_read_params *params,
			 const void *data, u16_t length)
{
	printf("Read complete: err %u length %u\n", err, length);

	if (!data) {
		memset(params, 0, sizeof(*params));
		return BT_GATT_ITER_STOP;
	}

	gatt_char_decl_attr* attr = (gatt_char_decl_attr*) data;

	read_params()

	bt_gatt_read(conn, &read_params);

	return BT_GATT_ITER_CONTINUE;
}*/

static u8_t gatt_discover_cb(struct bt_conn *conn,
			     const struct bt_gatt_attr *attr,
			     struct bt_gatt_discover_params *params)
{
	int err;

	if (!attr) {
		printk("Discover complete\r\n");
		memset(params, 0, sizeof(*params));
		return BT_GATT_ITER_STOP;
	}

	printk("[ATTRIBUTE] handle %u\r\n", attr->handle);

	if (bt_uuid_cmp(discover_params.uuid, BT_UUID_HIDS) == 0)
	{
		// First level of parsing: we found HID Service.
		// Lets look for the BT_UUID_HIDS_REPORT_MAP characteristic
		// This characteristic contains the HID report descriptor
		memcpy(&uuid, BT_UUID_HIDS_REPORT_MAP, sizeof(uuid));
		discover_params.uuid = &uuid.uuid;
		discover_params.start_handle = attr->handle + 1;
		discover_params.type = BT_GATT_DISCOVER_CHARACTERISTIC;

		err = bt_gatt_discover(conn, &discover_params);
		if (err) {
			printk("Discover failed (err %d)\r\n", err);
		}
	} 
	else if (bt_uuid_cmp(discover_params.uuid, BT_UUID_HIDS_REPORT_MAP) == 0) 
	{
		// Second level of parsing: we found the BT_UUID_HIDS_REPORT_MAP,
		// characteristic, which contains the HID report descriptor
		/*read_params.func = gatt_read_cb;
		read_params.handle_count = 1;
		read_params.single.handle = attr->handle;
		read_params.single.offset = 0;
		
		bt_gatt_read(conn, &read_params);*/

		/*memcpy(&uuid, BT_UUID_GATT_CCC, sizeof(uuid));
		discover_params.uuid = &uuid.uuid;
		discover_params.start_handle = attr->handle + 2;
		discover_params.type = BT_GATT_DISCOVER_DESCRIPTOR;
		subscribe_params.value_handle = attr->handle + 1;

		err = bt_gatt_discover(conn, &discover_params);
		if (err) {
			printk("Discover failed (err %d)\n", err);
		}*/

	}/* else {
		subscribe_params.notify = notify_func;
		subscribe_params.value = BT_GATT_CCC_NOTIFY;
		subscribe_params.ccc_handle = attr->handle;

		err = bt_gatt_subscribe(conn, &subscribe_params);
		if (err && err != -EALREADY) {
			printk("Subscribe failed (err %d)\n", err);
		} else {
			printk("[SUBSCRIBED]\n");
		}

		return BT_GATT_ITER_STOP;
	}*/

	return BT_GATT_ITER_STOP;
}


// Check to see if a bluetooth address is already associated with a device in the 
// global BT device list
bool is_address_in_device_list(const bt_addr_le_t* addr)
{
	for (uint32_t i = 0; i < ARRAY_SIZE(g_device_list.devices); i++)
	{
		if (g_device_list.devices[i].is_valid)
		{
			if (bt_addr_le_cmp(&g_device_list.devices[i].address, addr) == 0)
			{
				return true;
			}
		}
	}

	return false;
}

// Returns a pointer to the first empty BT_DEVICE structure in the global
// device list.
// The global device list lock must be taken before calling this function
BT_DEVICE* get_empty_device_list_slot()
{
	BT_DEVICE* empty_slot = NULL;

	for (uint32_t i = 0; i < ARRAY_SIZE(g_device_list.devices); i++)
	{
		if (g_device_list.devices[i].is_valid == false)
		{
			empty_slot = &g_device_list.devices[i];
			break;
		}
	}

	return empty_slot;
}

void initialize_device_list()
{
	memset(&g_device_list.devices, 0, ARRAY_SIZE(g_device_list.devices));
	k_mutex_init(&g_device_list.lock);
}
```

## src/bt.h
```c
#pragma once

#include <bluetooth\bluetooth.h>
#include <bluetooth\uuid.h>

#include <assert.h>

//
// Defines
//
#define BT_MAX_NAME_LEN 30
#define BT_MAX_SCANNED_DEVICES 20

//
// Typedefs
//

typedef struct {
    char                name[BT_MAX_NAME_LEN];
    bt_addr_le_t        address;
    bool                is_hid_device;
    bool                is_valid;
} BT_DEVICE;

// TODO: An array may not be the right data structure for this, but it works for now.
//       Investigate using one of the kernel data structures for this list
// TODO: An "announce updated" message might not be the best way to handle passing device
//       info arround. Consider re-organizing at a later date
typedef struct {

    BT_DEVICE devices[BT_MAX_SCANNED_DEVICES];
    struct k_mutex lock;
} BT_DEVICE_LIST;

//
// Public variables
//
extern BT_DEVICE_LIST g_device_list;

//
// Public function definitions
//

void bluetooth_task(void *arg1, void *arg2, void *arg3);
void take_device_list_lock();
void release_device_list_lock();
```

## src/hog_parser.c
```c
#include <zephyr.h>
#include <ring_buffer.h>

#include "messages.h"
#include "hog_parser.h"

/** Summary:
 *		The HID-over-GATT (HOG) parser task is designed to parse the GATT Profile information 
 *		provided by a bluetooth device. 
 
 *
 *		The Zephyr BT LE GATT API's are designed to run asynchronously. To perform the HOG profile parsing, the host must
 *		execute a set of operations in order, following a state machine. 
 * 
 * 
 *
 */

//
// Typedefs
//

// This enum defines the events that the HID-over-GATT parser task will respond to
typedef enum {
	GATT_PARSE_BEGIN,			// Start the parsing sequence
	GATT_DISCOVER_COMPLETE,		// The paser has finished a GATT Discovery operation
    GATT_READ_COMPLETE,    	    // The parser has finished a GATT Read operation

    // !!! INSERT NEW MESSAGES ABOVE THIS LINE !!!
    HOG_PARSER_MESSAGE_COUNT
} HOG_PARSER_COMMAND;

typedef struct {
    uint8_t command;
} HOG_PARSER_MESSAGE;

// TODO: maybe get a state machine library to build this out?
typedef enum {

	HOGP_STATE_INIT,
	HOGP_STATE_HID_SVC_DISCOVER,
	HOGP_STATE_HID_REPORT_MAP_CHAR_DISCOVER,
	HOGP_STATE_HID_REPORT_MAP_CHAR_READ,

	// TODO: more states

	HOGP_STATE_COMPLETE,							// The last state in a successful HOG parse
	HOGP_STATE_INVALID,								// This state can be entered from any other state to indicate an error has occurred

	// !!! INSERT NEW STATES ABOVE THIS LINE !!!
	HOG_PARSER_STATE_COUNT
} HOG_PARSER_STATE;

#define GATT_READ_BUFFER_SIZE 512
typedef struct {
	HOG_PARSER_STATE current_state;		// The current state
	HOG_PARSER_STATE next_state;		// The state should we transition to next
	bool ready_to_advance;				// Is the current state ready to advance to the next state?

	// Bluetooth connection info
	struct bt_conn* conn;

	// GATT Discovery Context
	int discover_status;
	struct bt_gatt_attr attr;

	// GATT Read Context
	int read_status;
	// TODO: update to latest version of Zephyr
	// 		 and convert this into a byte ring buffer
	uint32_t read_buffer_index;
	uint8_t read_buffer[GATT_READ_BUFFER_SIZE];

} HOG_PARSER_CONTEXT;

#define HID_REPORT_DESCRIPTOR_BUFFER_SIZE 512
uint32_t s_hid_report_descriptor_size;
uint8_t s_hid_report_descriptor[HID_REPORT_DESCRIPTOR_BUFFER_SIZE];

//
// Private variable definitions
//

static struct bt_uuid_16                uuid = BT_UUID_INIT_16(0);
static struct bt_gatt_discover_params   discover_params;
static struct bt_gatt_read_params       read_params;

K_MSGQ_DEFINE(hog_parser_task_queue, sizeof(HOG_PARSER_MESSAGE), 10, 4);

static HOG_PARSER_CONTEXT s_context;

//
// Private function declarations
//

static u8_t gatt_discover_cb(struct bt_conn *conn,
			     const struct bt_gatt_attr *attr,
			     struct bt_gatt_discover_params *params);

static u8_t gatt_read_cb(struct bt_conn *conn, u8_t err,
			 struct bt_gatt_read_params *params,
			 const void *data, u16_t length);

static void hog_state_machine(HOG_PARSER_MESSAGE* message);
static void hogp_state_init(HOG_PARSER_MESSAGE* message);
static void hogp_state_hid_svc_discover(HOG_PARSER_MESSAGE* message);
static void hogp_state_hid_report_map_char_discover(HOG_PARSER_MESSAGE* message);
static void hogp_state_hid_report_map_char_read(HOG_PARSER_MESSAGE* message);

static void hog_parser_send_event(HOG_PARSER_COMMAND event);
static void hogp_change_state(HOG_PARSER_STATE state);

//
// Public function definitions
//

void hog_parser_task(void *bt_conn, void *arg2, void *arg3)
{
	bool parsing_in_progress = true;
	HOG_PARSER_MESSAGE message;
	int status;

	// Setup the task's context block
	// TODO: functionize
	s_context.current_state = HOGP_STATE_INIT;
	s_context.ready_to_advance = false;
	s_context.next_state = HOGP_STATE_INVALID;

	s_context.conn = (struct bt_conn*) bt_conn;

	// Kick start the state machine
	hog_parser_send_event(GATT_PARSE_BEGIN);

	// TODO: we may not want this task to exit
	while(parsing_in_progress)
	{
		status = k_msgq_get(&hog_parser_task_queue, &message, K_FOREVER);

		printf("HOGP EVENT: %d\r\n", message.command);

		// Run the state machine parser now that we've completed an action
		// Always run the state machine at least once. If the ready_to_advance flag is
		// set, continue to run the state machine until it is no longer set.
		do
		{
			hog_state_machine(&message);
		} while (s_context.ready_to_advance);
	}
}

static void hog_state_machine(HOG_PARSER_MESSAGE* message)
{
	// Advance to the next state if needed.
	if (s_context.ready_to_advance)
	{
		printf("HOGP State machine advancing states: %d -> %d\r\n", s_context.current_state, s_context.next_state);
		s_context.current_state = s_context.next_state;
		s_context.next_state = HOGP_STATE_INVALID;
		s_context.ready_to_advance = false;

		// Change the message to GATT_PARSE_BEGIN to indicate that
		// this is the first entry into the new state
		message->command = GATT_PARSE_BEGIN;
	}

	switch (s_context.current_state)
	{
		// The state machine has just been initialized. We should start parsing the GATT Profile.
		// Send a service discovery request for the HID Service.
		case HOGP_STATE_INIT:
			hogp_state_init(message);
			break;

		case HOGP_STATE_HID_SVC_DISCOVER:
			hogp_state_hid_svc_discover(message);
			break;

		case HOGP_STATE_HID_REPORT_MAP_CHAR_DISCOVER:
			hogp_state_hid_report_map_char_discover(message);
			break;

		case HOGP_STATE_HID_REPORT_MAP_CHAR_READ:
			hogp_state_hid_report_map_char_read(message);
			break;

		case HOGP_STATE_COMPLETE:
			__ASSERT(false, "HOG PARSE STATE MACHINE ERROR!!!!");
			break;
	}
}

static void hogp_state_init(HOG_PARSER_MESSAGE* message)
{
	switch((HOG_PARSER_COMMAND) message->command)
	{
		case GATT_PARSE_BEGIN:
			// TODO: reset all state machine parameters
			hogp_change_state(HOGP_STATE_HID_SVC_DISCOVER);
			break;

		// Invalid state transition
		default:
			printf("INVALID COMMAND %d\r\n", message->command);
			__ASSERT(false, "INVALID STATE TRANSITION");
			break;
	}
}

static void hogp_state_hid_svc_discover(HOG_PARSER_MESSAGE* message)
{
	switch((HOG_PARSER_COMMAND) message->command)
	{
		case GATT_PARSE_BEGIN:
			// Discover the HID Service on the connected device
			memcpy(&uuid, BT_UUID_HIDS, sizeof(uuid));
			discover_params.uuid = &uuid.uuid;
			discover_params.func = gatt_discover_cb;
			discover_params.start_handle = 0x0001;
			discover_params.end_handle = 0xffff;
			discover_params.type = BT_GATT_DISCOVER_PRIMARY;

			int status = bt_gatt_discover(s_context.conn, &discover_params);
			if (status) {
				printf("Discover failed (err %d)\r\n", status);
			}
			break;

		case GATT_DISCOVER_COMPLETE:
			// If we found the HID Service, advance to the next state
			// Else, error out of the state machine
			if (s_context.discover_status == 0)
			{
				hogp_change_state(HOGP_STATE_HID_REPORT_MAP_CHAR_DISCOVER);
			}
			else
			{
				hogp_change_state(HOGP_STATE_INVALID);
			}
			break;

		// Invalid state transition
		default:
			__ASSERT(false, "INVALID STATE TRANSITION");
			break;
	}
}

static void hogp_state_hid_report_map_char_discover(HOG_PARSER_MESSAGE* message)
{
	switch((HOG_PARSER_COMMAND) message->command)
	{
		case GATT_PARSE_BEGIN:
			printf("Discovering HID Report Map Characteristic\r\n");
			// Discover the HID Report Map (Basically the HID Report Descriptor)
			// on the connected device
			memcpy(&uuid, BT_UUID_HIDS_REPORT_MAP, sizeof(uuid));
			discover_params.uuid = &uuid.uuid;
			discover_params.func = gatt_discover_cb;

			// Search handle IDs in range [ (HID Service Handle + 1), (MAX_HANDLE) ]
			discover_params.start_handle = s_context.attr.handle + 1;
			discover_params.end_handle = 0xffff;
			discover_params.type = BT_GATT_DISCOVER_CHARACTERISTIC;

			int status = bt_gatt_discover(s_context.conn, &discover_params);
			if (status) {
				printf("Discover failed (err %d)\r\n", status);
			}
			break;

		case GATT_DISCOVER_COMPLETE:
			// If we found the Characteristic, advance to the read state
			// Else, error out of the state machine
			if (s_context.discover_status == 0)
			{
				hogp_change_state(HOGP_STATE_HID_REPORT_MAP_CHAR_READ);
			}
			else
			{
				hogp_change_state(HOGP_STATE_INVALID);
			}
			break;

		// Invalid state transition
		default:
			__ASSERT(false, "INVALID STATE TRANSITION");
			break;
	}
}

static void hogp_state_hid_report_map_char_read(HOG_PARSER_MESSAGE* message)
{
	static int read_count = 0;
	int status;

	switch((HOG_PARSER_COMMAND) message->command)
	{
		case GATT_PARSE_BEGIN:
			printf("Reading HID Report Map Characteristic Declaration Attr\r\n");
			// Reset our local read count, in case we've been called twice
			read_count = 0;

			// Read the HID Report Map GATT Characteristic Declaration Attribute
			read_params.func = gatt_read_cb;
			read_params.handle_count = 1;
			read_params.single.handle = s_context.attr.handle;
			read_params.single.offset = 0;

			// Reset GATT Read context
			s_context.read_buffer_index = 0;
			memset(s_context.read_buffer, 0, GATT_READ_BUFFER_SIZE);

			status = bt_gatt_read(s_context.conn, &read_params);
			if (status) 
			{
				printf("Discover failed (err %d)\r\n", status);
			}
			break;

		case GATT_READ_COMPLETE:
			if (s_context.read_status == 0)
			{
				// First read should be the GATT Characteristic Declaration Attribute
				if (read_count == 0)
				{
					read_count++;

					// TODO: allow any of the 3 sizes of Char Decl Attrs (5, 7, 19 bytes)
					if (s_context.read_buffer_index != 5)
					{
						printf("ERROR: Invalid Char Decl Attr size %u\r\n", s_context.read_buffer_index);
						hogp_change_state(HOGP_STATE_INVALID);
						return;
					}

					gatt_char_decl_attr* attribute = (gatt_char_decl_attr*) s_context.read_buffer;

					printf("Reading HID Report Map Characteristic Value Attr\r\n");
					// Read the HID Report Map GATT Characteristic Declaration Attribute
					read_params.func = gatt_read_cb;
					read_params.handle_count = 1;
					read_params.single.handle = attribute->char_val_handle;
					read_params.single.offset = 0;

					// Reset GATT Read context
					s_context.read_buffer_index = 0;
					memset(s_context.read_buffer, 0, GATT_READ_BUFFER_SIZE);

					status = bt_gatt_read(s_context.conn, &read_params);
					if (status) 
					{
						printf("Discover failed (err %d)\r\n", status);
					}
				}
				// Second read, should be the GATT Characteristic Value itself
				else
				{
					printf("GOT HID REPORT DESCRIPTOR\r\n");
					memcpy(s_hid_report_descriptor, s_context.read_buffer, min(s_context.read_buffer_index, HID_REPORT_DESCRIPTOR_BUFFER_SIZE));
					s_hid_report_descriptor_size = s_context.read_buffer_index;

					for (uint32_t i = 0; i < s_hid_report_descriptor_size; i++)
					{
						printf("0x%x\r\n", ((uint8_t*) s_hid_report_descriptor)[i]);
					}
				}
			}
			else
			{
				hogp_change_state(HOGP_STATE_INVALID);
			}
			break;

		// Invalid state transition
		default:
			__ASSERT(false, "INVALID STATE TRANSITION");
			break;
	}
}

static void hog_parser_send_event(HOG_PARSER_COMMAND event)
{
	HOG_PARSER_MESSAGE message;
	message.command = event;

	while (k_msgq_put(&hog_parser_task_queue, &message, K_NO_WAIT) != 0) 
	{
		// message queue is full: purge old data & try again
		k_msgq_purge(&hog_parser_task_queue);
	}
}

static void hogp_change_state(HOG_PARSER_STATE state)
{
	printf("Change state to %d\r\n", state);
	s_context.next_state = state;
	s_context.ready_to_advance = true;
}

static u8_t gatt_discover_cb(struct bt_conn *conn,
			     const struct bt_gatt_attr *attr,
			     struct bt_gatt_discover_params *params)
{
	if (attr)
	{
		// We found the requested attribute. Copy it into s_context, and emit a GATT_DISCOVER_COMPLETE event
		memcpy(&s_context.attr, attr, sizeof(struct bt_gatt_attr));
		s_context.discover_status = 0;
	}
	else
	{
		s_context.discover_status = -EEXIST;
	}

	hog_parser_send_event(GATT_DISCOVER_COMPLETE);

	return BT_GATT_ITER_STOP;
}

static u8_t gatt_read_cb(struct bt_conn *conn, u8_t err,
			 struct bt_gatt_read_params *params,
			 const void *data, u16_t length)
{
	printf("Read complete: err %u length %u\r\n", err, length);

	// No more data to read. Mark the read as complete and emit our signal
	// to the HOGP task
	if (!data) 
	{	
		memset(params, 0, sizeof(*params));
		s_context.read_status = err;
		hog_parser_send_event(GATT_READ_COMPLETE);

		return BT_GATT_ITER_STOP;
	}

	// Push this data into the GATT Read ring buffer

	// If we're out of space in the read buffer, abort. Set read_status to an error
	// and signal the task.
	if (s_context.read_buffer_index >= GATT_READ_BUFFER_SIZE)
	{
		printf("ERROR: gatt_read requires larger buffer than GATT_READ_BUFFER_SIZE\r\n");
		s_context.read_status = -ENOMEM;
		hog_parser_send_event(GATT_READ_COMPLETE);

		return BT_GATT_ITER_STOP;
	}

	memcpy(&s_context.read_buffer[s_context.read_buffer_index], 
		   (uint8_t*) data, 
		   min(length, GATT_READ_BUFFER_SIZE));

	for (uint32_t i = 0; i < length; i++)
	{
		printf("0x%x\r\n", ((uint8_t*) data)[i]);
	}

	s_context.read_buffer_index += min(length, GATT_READ_BUFFER_SIZE);

	return BT_GATT_ITER_CONTINUE;
}
```

## src/hog_parser.h
```c
#pragma once

#include <bluetooth/bluetooth.h>
#include <bluetooth/conn.h>
#include <bluetooth/uuid.h>
#include <bluetooth/gatt.h>
#include <assert.h>

//
// Typedefs
// 

typedef u8_t (*bt_gatt_read_char_value_func_t)(struct bt_conn *conn,
				      struct bt_gatt_subscribe_params *params,
				      const void *data, u16_t length);

typedef struct
{
    struct bt_uuid_16 uuid;
    struct bt_gatt_discover_params discover_params;
    struct bt_gatt_read_params read_params;
    bt_gatt_read_char_value_func_t notify;
} bt_gatt_read_char_value_params;

#pragma pack(push, 1)
typedef struct {
    uint8_t properties;
    uint16_t char_val_handle;
    union {
        uint16_t uuid2;
        uint32_t uuid4;
        uint8_t  uuid16[16];
    } uuid;
} gatt_char_decl_attr;
#pragma pack(pop)
static_assert(sizeof(gatt_char_decl_attr) == 19, "Characteristic Declaration Value must be 19 bytes");

// 
// Public Functions
// 

void hog_parser_task(void *arg1, void *arg2, void *arg3);
```

## src/imu.h
```c
#pragma once

void imu_task(void *arg1, void *arg2, void *arg3);
```

## src/messages.c
```c
#include <zephyr.h>
#include "messages.h"

K_MSGQ_DEFINE(bluetooth_task_queue, sizeof(BLUETOOTH_TASK_MESSAGE), 10, 4);

K_MSGQ_DEFINE(ui_task_queue, sizeof(UI_TASK_MESSAGE), 10, 4);
```

## src/temperature.h
```c
#pragma once

void temperature_task(void *arg1, void *arg2, void *arg3);
```

## src/ui.h
```c
#pragma once

void ui_task(void *arg1, void *arg2, void *arg3);
```
