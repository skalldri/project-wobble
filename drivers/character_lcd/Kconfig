## drivers/character_lcd/Kconfig
```kconfig
# Kconfig - Character LCD drivers

menuconfig CHARACTER_LCD
	bool
	prompt "Character LCD Drivers"
	help
	  Enable Character LCD drivers

if CHARACTER_LCD

source "drivers/character_lcd/Kconfig.lcd1602"

endif # CHARACTER_LCD
```

## drivers/character_lcd/Kconfig.lcd1602
```kconfig
# Kconfig - LCD1602 I2C Character LCD device configuration options

menuconfig LCD1602
	bool
	prompt "LCD1602 I2C Character LCD Device"
	depends on I2C
	help
	  Enable driver for LCD1602 I2C-based character LCD device.

config LCD1602_NAME
	string
	prompt "Driver name"
	default "LCD1602"
	depends on LCD1602
	help
	  Device name with which the LCD1602 sensor is identified.

config LCD1602_I2C_ADDR
	hex
	prompt "I2C address"
	depends on LCD1602
	default 0x27
	range 0x20 0x27
	help
	  I2C address of the LCD1602 device.
	  See the PCF8574 datasheet for information on determining the I2C address.

config LCD1602_I2C_MASTER_DEV_NAME
	string
	prompt "I2C master where LCD1602 is connected"
	depends on LCD1602
	default "I2C_0"
	help
	  Specify the device name of the I2C master device to which LCD1602 is
	  connected.

config LCD1602_LCD_COLUMNS
	int
	prompt "LCD Columns"
	depends on LCD1602
	help
	  Number of columns the on the display attached to the LCD1602.

config LCD1602_LCD_ROWS
	int
	prompt "LCD Rows"
	depends on LCD1602
	help
	  Number of columns the on the display attached to the LCD1602.
```

## drivers/oled/Kconfig.ssd1306
```kconfig
# Kconfig - SSD1306 display driver configuration options

config SSD1306
	bool "SSD1306 OLED Display Driver"
	depends on I2C
	help
	  Driver for the SSD1306 OLED display driver (I2C)

config SSD1306_NAME
	string
	prompt "Driver name"
	default "SSD1306"
	depends on SSD1306
	help
	  Device name with which the SSD1306 sensor is identified.

config SSD1306_I2C_ADDR
	hex
	prompt "I2C address"
	depends on SSD1306
	default 0x3C
	range 0x3C 0x3D
	help
	  I2C address of the SSD1306 device.
	  See the SSD1306 datasheet for information on determining the I2C address.

config SSD1306_I2C_MASTER_DEV_NAME
	string
	prompt "I2C master where SSD1306 is connected"
	depends on SSD1306
	default "I2C_0"
	help
	  Specify the device name of the I2C master device to which SSD1306 is
	  connected.

config SSD1306_OLED_ROWS
	int
	prompt "OLED Rows"
	depends on SSD1306
	default 32
	range 32 64
	help
	  Number of rows the on the OLED display attached to the SSD1306.
	  NOTE: The only valid values are 32 and 64! Values in-between are not valid.
```
